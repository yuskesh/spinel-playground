## CMakeLists.txt
```
# Timer probe for tests/app/platform-facts.sh (decision 0014, Task 1).
cmake_minimum_required(VERSION 3.20.0)
find_package(Zephyr REQUIRED HINTS $ENV{ZEPHYR_BASE})
project(spinel_timer_probe)
target_sources(app PRIVATE src/main.c)
```

## prj.conf
```kconfig
# The probe reads k_cycle_get_64() inside a k_timer expiry. On mps2/an521 the
# system timer is SysTick at 25 MHz, below the 60 MHz at which Zephyr enables
# the 64-bit software count by default, so it is enabled here explicitly.
CONFIG_CORTEX_M_SYSTICK_64BIT_CYCLE_COUNTER=y
CONFIG_GPIO=y
CONFIG_GPIO_EMUL=y
CONFIG_ADC=y
CONFIG_ADC_EMUL=y
```

## emul.overlay
```dts
/* The two emulators 0014 relies on, added to a board that has neither. */
/ {
	spinel_adc_emul: adc-emul {
		compatible = "zephyr,adc-emul";
		nchannels = <2>;
		ref-internal-mv = <3300>;
		#io-channel-cells = <1>;
		status = "okay";
	};

	spinel_gpio_emul: gpio-emul {
		compatible = "zephyr,gpio-emul";
		rising-edge;
		falling-edge;
		gpio-controller;
		#gpio-cells = <2>;
		ngpios = <8>;
		status = "okay";
	};
};
```

## src/main.c
```c
/*
 * Timer probe for tests/app/platform-facts.sh (decision 0014, Task 1).
 *
 * It establishes, on the pinned Zephyr under QEMU, that k_cycle_get_64()
 * advances inside a k_timer expiry function that busy-waits, that the expiry
 * runs in interrupt context, and that the ADC and GPIO emulators added by
 * emul.overlay come up. Every line it prints starts with PROBE, and the last
 * one is "PROBE end"; the script keys on those.
 */
#include <zephyr/kernel.h>
#include <zephyr/device.h>
#include <zephyr/devicetree.h>
#include <zephyr/drivers/adc.h>
#include <zephyr/drivers/gpio.h>
#include <zephyr/sys/printk.h>

#define BUSY_US 2000

static struct k_timer probe_timer;
static volatile uint64_t cycles_before;
static volatile uint64_t cycles_after;
static volatile int expiry_in_isr;
static volatile int fired;

static void expiry(struct k_timer *timer)
{
	ARG_UNUSED(timer);
	expiry_in_isr = k_is_in_isr();
	cycles_before = k_cycle_get_64();
	k_busy_wait(BUSY_US);
	cycles_after = k_cycle_get_64();
	fired = 1;
}

int main(void)
{
	const struct device *adc = DEVICE_DT_GET(DT_NODELABEL(spinel_adc_emul));
	const struct device *gpio = DEVICE_DT_GET(DT_NODELABEL(spinel_gpio_emul));

	printk("PROBE start cycles_per_sec=%u has_64bit_counter=%d\n",
	       sys_clock_hw_cycles_per_sec(),
	       IS_ENABLED(CONFIG_TIMER_HAS_64BIT_CYCLE_COUNTER));

	k_timer_init(&probe_timer, expiry, NULL);
	k_timer_start(&probe_timer, K_MSEC(10), K_NO_WAIT);
	while (!fired) {
		k_msleep(1);
	}
	printk("PROBE timer busy_us=%d before=%llu after=%llu delta=%llu in_isr=%d\n",
	       BUSY_US, (unsigned long long)cycles_before,
	       (unsigned long long)cycles_after,
	       (unsigned long long)(cycles_after - cycles_before), expiry_in_isr);

	printk("PROBE emul adc_ready=%d gpio_ready=%d\n",
	       device_is_ready(adc) ? 1 : 0, device_is_ready(gpio) ? 1 : 0);
	printk("PROBE end\n");
	return 0;
}
```
