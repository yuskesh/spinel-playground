## CMakeLists.txt
```
cmake_minimum_required(VERSION 3.20.0)
find_package(Zephyr REQUIRED HINTS $ENV{ZEPHYR_BASE})
project(e083_kernel_optimizer_loop)

# TWO generated objects, which is the experiment: spinel-mlirgen's kernel
# (whose `calibrate` IMPORTS spinel_grad_sq_hinge_loss as a platform extern
# declared by the profile) and spinel-gradfs's --grads-only object (which
# defines that one symbol).  "The platform supplies a declared extern" is,
# on Zephyr, exactly this second line of link input -- west links it the way
# E081 compiled a wrapper C file (P003 principle 7: the final link is the
# platform's job).
if(NOT DEFINED SPINEL_OBJ)
  message(FATAL_ERROR "-DSPINEL_OBJ=<path to kern.<profile>.o> is required")
endif()
if(NOT DEFINED SPINEL_GRAD_OBJ)
  message(FATAL_ERROR "-DSPINEL_GRAD_OBJ=<path to grad.<profile>.o> is required")
endif()
if(NOT DEFINED SPINEL_GEN_DIR)
  message(FATAL_ERROR "-DSPINEL_GEN_DIR=<dir with the generated headers> is required")
endif()
if(NOT DEFINED E083_DRV_DIR)
  message(FATAL_ERROR "-DE083_DRV_DIR=<dir with e083_drv.c> is required")
endif()

target_sources(app PRIVATE src/main.c)
target_include_directories(app PRIVATE ${SPINEL_GEN_DIR} ${E083_DRV_DIR})
if(DEFINED E083_TRAP)
  target_compile_definitions(app PRIVATE E083_TRAP=${E083_TRAP})
endif()

zephyr_link_libraries(${SPINEL_OBJ} ${SPINEL_GRAD_OBJ})
```

## prj.conf
```kconfig
CONFIG_PRINTK=y
# The canonical value ABI is 64-bit (P003 D-1), so %lld has to work in the
# trap hook's diagnostic.
CONFIG_PICOLIBC_IO_LONG_LONG=y
# As in E079: no CONFIG_PICOLIBC_IO_FLOAT / CONFIG_CBPRINTF_FP_SUPPORT -- the
# device prints IEEE bit patterns, never a decimal float, so the four-way
# comparison cannot be weakened by printf implementations, and `libm: none`
# stays true on both sides of the boundary.
CONFIG_MAIN_STACK_SIZE=8192
```

## src/main.c
```c
/* E083 -- the DEVICE leg (Cortex-M33 / RV32 under QEMU).
 *
 * Zephyr glue and nothing else.  The driver is drv/e083_drv.c, byte-identical
 * to the one the native leg compiles; the prototypes come from
 * `spinel-mlirgen --emit-header`.  What is new compared with E079's device:
 * the image holds the SGD loop INSIDE the kernel object -- main.c calls no
 * gradient function and holds no loop; the kernel calls the adjoint through
 * the platform extern the profile declares, and west linked the adjoint
 * object next to it (see ../CMakeLists.txt).
 *
 * The trap hook panics: nothing in the calibration stream is supposed to
 * trap, so the honest hook is the one a sensor node would ship (E067 s5).
 * The E083_TRAP probe build relies on exactly that -- the UNREACHED line
 * must never print because k_panic() does not return.
 */
#include <zephyr/kernel.h>
#include <zephyr/sys/printk.h>
#include <stdint.h>

#include "spinel_freestanding.h"

void spinel_trap(int32_t code, int64_t a, int64_t b, const char *detail)
{
	printk("E083\tTRAP\tcode=%d a=%lld b=%lld detail=%s\n",
	       (int)code, (long long)a, (long long)b, detail);
	k_panic();
	for (;;) {
	}
}

#define E083_PRINT(...) printk(__VA_ARGS__)
#include "e083_drv.c"

int main(void)
{
	e083_main();
	return 0;
}
```
