## CMakeLists.txt
```
cmake_minimum_required(VERSION 3.20.0)
find_package(Zephyr REQUIRED HINTS $ENV{ZEPHYR_BASE})
project(e079_edge_calibration)

# Everything interesting is generated: the object (kernel + Enzyme adjoint in
# one .o, from spinel-gradfs), the two headers, and -- for the shipped build --
# the weights the edge computed.  Zephyr only links and runs (P003 principle 7).
if(NOT DEFINED SPINEL_OBJ)
  message(FATAL_ERROR "-DSPINEL_OBJ=<path to grad.<profile>.o> is required")
endif()
if(NOT DEFINED SPINEL_GEN_DIR)
  message(FATAL_ERROR "-DSPINEL_GEN_DIR=<dir with the generated headers> is required")
endif()
if(NOT DEFINED E079_DRV_DIR)
  message(FATAL_ERROR "-DE079_DRV_DIR=<dir with e079_drv.c> is required")
endif()

target_sources(app PRIVATE src/main.c)
target_include_directories(app PRIVATE ${SPINEL_GEN_DIR} ${E079_DRV_DIR})
if(DEFINED E079_SHIPPED)
  target_compile_definitions(app PRIVATE E079_SHIPPED=1)
endif()

zephyr_link_libraries(${SPINEL_OBJ})
```

## prj.conf
```kconfig
CONFIG_PRINTK=y
# The canonical value ABI is 64-bit (P003 D-1), so %lld has to work in the
# trap hook's diagnostic.
CONFIG_PICOLIBC_IO_LONG_LONG=y
# NOTE what is NOT here: CONFIG_PICOLIBC_IO_FLOAT / CONFIG_CBPRINTF_FP_SUPPORT.
# E077 needed them because it printed doubles as decimal; E079 prints the 16
# hex digits of the bit pattern instead (drv/e079_drv.c explains why), so the
# device never formats a float.  That also means the four-way comparison
# cannot be quietly weakened by three different printf implementations.
# And `libm: none` stays true on both sides of the boundary.
CONFIG_MAIN_STACK_SIZE=8192
```

## src/main.c
```c
/* E079 -- the DEVICE leg (Cortex-M33 / RV32 under QEMU).
 *
 * This file is Zephyr glue and nothing else.  The driver is
 * drv/e079_drv.c, byte-identical to the one the native leg compiles, and the
 * prototypes come from `spinel-mlirgen --emit-header` and
 * `spinel-gradfs --emit-header` -- so neither the calibration nor the
 * signatures are transcribed by hand.
 *
 * WHAT IS NEW COMPARED WITH E077's DEVICE: the image contains an Enzyme
 * adjoint.  Nothing about the platform changes because of that -- same one
 * import (`spinel_trap`), same absence of an allocator, same soft float.  The
 * gradient is ordinary code with an unusual provenance.
 *
 * The trap hook panics.  E077 kept a longjmp variant because it needed all its
 * broken cases to run in one image; here nothing is supposed to trap, so the
 * honest hook is the one a sensor node would ship: stop, and do not sign
 * anything else (E067 s5).
 */
#include <zephyr/kernel.h>
#include <zephyr/sys/printk.h>
#include <stdint.h>

#include "spinel_freestanding.h"
#include "spinel_grad.h"

void spinel_trap(int32_t code, int64_t a, int64_t b, const char *detail)
{
	printk("E079\tTRAP\tcode=%d a=%lld b=%lld detail=%s\n",
	       (int)code, (long long)a, (long long)b, detail);
	k_panic();
	for (;;) {
	}
}

#define E079_PRINT(...) printk(__VA_ARGS__)
#include "e079_drv.c"

int main(void)
{
	e079_main();
	return 0;
}
```
