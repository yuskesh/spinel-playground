## CMakeLists.txt
```
cmake_minimum_required(VERSION 3.20.0)
find_package(Zephyr REQUIRED HINTS $ENV{ZEPHYR_BASE})
project(e081_platform_extern)

# The freestanding object, its generated header and the generated case table
# come from spinel-mlirgen / mkcases.py; Zephyr links and runs (P003 design
# principle 7).  New in E081: a second app TU, spinel_zephyr.c -- the platform
# wrappers the kernel imports.  It #includes the generated header, so the
# profile's extern declarations are enforced on it by Zephyr's own compiler.
if(NOT DEFINED SPINEL_OBJ)
  message(FATAL_ERROR "-DSPINEL_OBJ=<path to kern.o> is required")
endif()
if(NOT DEFINED SPINEL_GEN_DIR)
  message(FATAL_ERROR "-DSPINEL_GEN_DIR=<dir with spinel_freestanding.h and cases.inc> is required")
endif()

target_sources(app PRIVATE src/main.c src/spinel_zephyr.c)
target_include_directories(app PRIVATE ${SPINEL_GEN_DIR})
if(DEFINED E081_PANIC_TRAP)
  target_compile_definitions(app PRIVATE E081_PANIC_TRAP=1)
endif()

zephyr_link_libraries(${SPINEL_OBJ})
```

## prj.conf
```kconfig
CONFIG_PRINTK=y
# The canonical value ABI is 64-bit, so `%lld` has to work.
CONFIG_PICOLIBC_IO_LONG_LONG=y
# fsense rows print a double via snprintf %.17g.
CONFIG_PICOLIBC_IO_FLOAT=y
CONFIG_CBPRINTF_FP_SUPPORT=y
# The harness trap hook longjmps back into the driver (E040/E077 shape).
CONFIG_MAIN_STACK_SIZE=8192
# E081: the gpio_set/gpio_get wrappers drive the real GPIO driver where the
# board's devicetree has one (mps2/an521's FPGAIO LED register); on a board
# without one (qemu_riscv32) the wrapper falls back to its shadow array and
# says so in the log.
CONFIG_GPIO=y
```

## src/main.c
```c
/* E081 -- P003 Phase 4: the MCU legs of the four-way differential, plus the
 * device-only property rows.
 *
 * The case list is #included from the generated cases.inc (one table,
 * mkcases.py) and the prototypes come from the generated header, so nothing
 * here is transcribed.  The trap hook is E040/E077's harness shape: record
 * (code, detail) and longjmp back into the driver so all cases run in one
 * image; a second build (-DE081_PANIC_TRAP=1) runs exactly one narrowing case
 * and k_panic()s, so "an extern-argument trap really is fatal" does not rest
 * on the harness's convenience implementation.
 *
 * After the cases, the PROPERTY rows: the things that are true on a real
 * platform but are not values a host oracle can share --
 *   uptime_monotonic  two k_uptime_get() reads around a k_msleep, t1 >= t0
 *   sleep_elapsed     the uptime delta covered the requested sleep
 *   print_witness     (checked by run_gates.sh: the E081P line printed by the
 *                     chirp case is in this same console log)
 *   gpio_backend      how many pins were driven through the real GPIO driver
 *                     (2 on mps2/an521, 0 on qemu_riscv32) -- E056's
 *                     field-of-view row, printed per run rather than assumed
 *   gpio_readback     set pin 0 through the wrapper, read it back through the
 *                     wrapper (on M33 that is a register readback from the
 *                     QEMU-emulated FPGAIO device)
 */
#include <zephyr/kernel.h>
#include <zephyr/sys/printk.h>
#include <setjmp.h>
#include <stdint.h>
#include <stdio.h>

#include "spinel_freestanding.h"

int e081_gpio_real_pins(void); /* spinel_zephyr.c */

static jmp_buf e081_jmp;
static volatile int e081_armed;
static volatile int e081_code;

void spinel_trap(int32_t code, int64_t a, int64_t b, const char *detail)
{
#ifdef E081_PANIC_TRAP
	printk("E081\tTRAP\tcode=%d a=%lld b=%lld detail=%s\n",
	       (int)code, (long long)a, (long long)b, detail);
	k_panic();
	for (;;) {
	}
#else
	(void)a;
	(void)b;
	e081_code = code;
	if (e081_armed) {
		longjmp(e081_jmp, 1);
	}
	printk("E081\tFATAL\tunarmed trap code=%d detail=%s\n", (int)code, detail);
	k_panic();
	for (;;) {
	}
#endif
}

static char e081_line[256];
static int e081_len;

static void e081_put(const char *s)
{
	while (*s && e081_len < (int)sizeof(e081_line) - 1) {
		e081_line[e081_len++] = *s++;
	}
	e081_line[e081_len] = 0;
}

static void e081_puti(long long v)
{
	char b[32];

	snprintf(b, sizeof b, "%lld", v);
	e081_put(b);
}

static void e081_putf(double v)
{
	char b[64];

	/* %.17g round-trips every double; Ruby and JS print shortest forms of
	 * the same value.  compare.py parses both sides (E077's honest form:
	 * float rows are a VALUE comparison, not a byte comparison). */
	snprintf(b, sizeof b, "%.17g", v);
	e081_put(b);
}

#define E081_BEGIN(name)                                                       \
	e081_len = 0;                                                          \
	e081_line[0] = 0;                                                      \
	e081_code = 0;                                                         \
	e081_armed = 1;                                                        \
	e081_put(name);                                                        \
	e081_put("\t");

#define E081_CASE_I(name, expr)                                                \
	do {                                                                   \
		E081_BEGIN(name)                                               \
		if (setjmp(e081_jmp) == 0) {                                   \
			long long _v = (long long)(expr);                      \
			e081_armed = 0;                                        \
			e081_puti(_v);                                         \
		} else {                                                       \
			e081_armed = 0;                                        \
			e081_put("trap:");                                     \
			e081_puti((long long)e081_code);                       \
		}                                                              \
		printk("E081\t%s\n", e081_line);                               \
	} while (0);

#define E081_CASE_F(name, expr)                                                \
	do {                                                                   \
		E081_BEGIN(name)                                               \
		if (setjmp(e081_jmp) == 0) {                                   \
			double _v = (double)(expr);                            \
			e081_armed = 0;                                        \
			e081_putf(_v);                                         \
		} else {                                                       \
			e081_armed = 0;                                        \
			e081_put("trap:");                                     \
			e081_puti((long long)e081_code);                       \
		}                                                              \
		printk("E081\t%s\n", e081_line);                               \
	} while (0);

#include "cases.inc"

static void e081_props(void)
{
	int64_t t0 = spinel_zephyr_uptime_ms();
	int32_t r = spinel_zephyr_sleep_ms(20);
	int64_t t1 = spinel_zephyr_uptime_ms();

	printk("E081\tPROP\tuptime_monotonic\t%d\n", t1 >= t0 ? 1 : 0);
	printk("E081\tPROP\tsleep_elapsed\t%d\n",
	       (t1 - t0 >= 20 && r == 0) ? 1 : 0);
	printk("E081\tPROP\tgpio_backend\treal_pins=%d\n", e081_gpio_real_pins());
	spinel_zephyr_gpio_set(0, 1);
	printk("E081\tPROP\tgpio_readback\t%d\n", (int)spinel_zephyr_gpio_get(0));
	spinel_zephyr_gpio_set(0, 0);
	printk("E081\tPROP\tgpio_readback0\t%d\n", (int)spinel_zephyr_gpio_get(0));
}

int main(void)
{
	printk("E081\tBEGIN\t%s\n", CONFIG_BOARD_TARGET);
#ifdef E081_PANIC_TRAP
	/* One case, and it is the ARGUMENT-narrowing one this experiment adds:
	 * pin 2**32+5 does not fit the extern's declared :i32.  If the panic
	 * build printed a number here, D-8's trap would be a harness fiction. */
	printk("E081\tpanic-probe\t%d\n",
	       (int)spinel_pin_probe(INT64_C(4294967301)));
	printk("E081\tUNREACHABLE\t0\n");
#else
	e081_run();
	e081_props();
	printk("E081\tEND\t0\n");
#endif
	return 0;
}
```

## src/spinel_zephyr.c
```c
/* E081 -- the Zephyr instance of the platform-extern surface (P003 Phase 4).
 *
 * These are the `spinel_zephyr_*` wrappers P003 s8 promised: the generator
 * never reads a Zephyr header, the kernel imports exactly these symbols, and
 * the profile (cortex-m33-zephyr-e081.yaml) is the single declaration both
 * sides are held to.  Two independent witnesses enforce the agreement:
 *
 *   1. tools/freestanding/extern-check.py scans this file's signatures
 *      against the profile (the transcription-lie gate);
 *   2. this TU #includes the GENERATED header (spinel_freestanding.h carries
 *      a prototype per declared extern), so Zephyr's own C compiler refuses a
 *      conflicting definition at build time -- the dynamic backing of the
 *      static scan (E062's lesson).
 *
 * THE GPIO BACKEND, stated exactly (E056: an instrument has a field of view).
 * The extern contract is a pin register file: pins 0..7, values 0..1,
 * `set` echoes the value written, `get` returns the last value set, -1
 * outside the range.  On mps2/an521 the board HAS a GPIO controller QEMU
 * models (the FPGAIO LED register, DT node gpio_led0, 2 pins), so pins 0..1
 * are READ AND WRITTEN THROUGH the real Zephyr GPIO driver -- a `get` on pin
 * 0 is a register readback from the emulated device, not a variable.  Pins
 * 2..7 (and every pin on qemu_riscv32, whose virt board has no GPIO node)
 * fall back to a shadow array in this wrapper.  main.c prints which backend
 * each build actually used (`E081  PROP  gpio_backend  ...`), so the claim in
 * the log is per-run, not per-comment.
 */
#include <zephyr/kernel.h>
#include <zephyr/sys/printk.h>
#include <zephyr/devicetree.h>
#include <stdint.h>

#include "spinel_freestanding.h"

#define E081_NPINS 8

static int32_t pin_shadow[E081_NPINS];

#if DT_NODE_HAS_STATUS(DT_NODELABEL(gpio_led0), okay) && defined(CONFIG_GPIO)
#include <zephyr/drivers/gpio.h>
#define E081_HAVE_GPIO 1
#define E081_REAL_PINS 2 /* the FPGAIO LED register has two pins */
static const struct device *const e081_gpio =
	DEVICE_DT_GET(DT_NODELABEL(gpio_led0));
static int e081_pin_is_real(int32_t pin)
{
	return pin >= 0 && pin < E081_REAL_PINS && device_is_ready(e081_gpio);
}
#else
static int e081_pin_is_real(int32_t pin)
{
	(void)pin;
	return 0;
}
#endif

int e081_gpio_real_pins(void)
{
#ifdef E081_HAVE_GPIO
	return device_is_ready(e081_gpio) ? E081_REAL_PINS : 0;
#else
	return 0;
#endif
}

int64_t spinel_zephyr_uptime_ms(void)
{
	return k_uptime_get();
}

int32_t spinel_zephyr_sleep_ms(int32_t ms)
{
	return k_msleep(ms);
}

int32_t spinel_zephyr_print_i64(int64_t v)
{
	/* A distinct prefix (E081P) so the differential's line extractor never
	 * mistakes a platform side effect for a case result. */
	printk("E081P\tprint\t%lld\n", (long long)v);
	return 0;
}

int32_t spinel_zephyr_gpio_set(int32_t pin, int32_t val)
{
	if (pin < 0 || pin >= E081_NPINS || val < 0 || val > 1) {
		return -1;
	}
	pin_shadow[pin] = val;
#ifdef E081_HAVE_GPIO
	if (e081_pin_is_real(pin)) {
		gpio_pin_set_raw(e081_gpio, (gpio_pin_t)pin, val);
	}
#endif
	return val;
}

int32_t spinel_zephyr_gpio_get(int32_t pin)
{
	if (pin < 0 || pin >= E081_NPINS) {
		return -1;
	}
#ifdef E081_HAVE_GPIO
	if (e081_pin_is_real(pin)) {
		return gpio_pin_get_raw(e081_gpio, (gpio_pin_t)pin);
	}
#endif
	return pin_shadow[pin];
}

double spinel_zephyr_sense_scale(float a, double b)
{
	return (double)a * 2.0 + b;
}

uint32_t spinel_zephyr_checksum32(uint32_t v)
{
	return v ^ 0xA5A5A5A5u;
}
```
