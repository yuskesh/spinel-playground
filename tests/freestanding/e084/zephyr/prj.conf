## CMakeLists.txt
```
cmake_minimum_required(VERSION 3.20.0)
find_package(Zephyr REQUIRED HINTS $ENV{ZEPHYR_BASE})
project(e084_kernel_newton)

# TWO generated objects, as in E083 -- but the adjoint object now defines TWO
# symbols: the reverse gradient AND the forward-over-reverse Hessian-vector
# product, both of which the kernel's Newton-CG loop imports as platform
# externs declared by the profile.  West links the pair the way E081 compiled
# a wrapper C file (P003 principle 7: the final link is the platform's job).
if(NOT DEFINED SPINEL_OBJ)
  message(FATAL_ERROR "-DSPINEL_OBJ=<path to kern.<profile>.o> is required")
endif()
if(NOT DEFINED SPINEL_GRAD_OBJ)
  message(FATAL_ERROR "-DSPINEL_GRAD_OBJ=<path to grad.<profile>.o> is required")
endif()
if(NOT DEFINED SPINEL_GEN_DIR)
  message(FATAL_ERROR "-DSPINEL_GEN_DIR=<dir with the generated headers> is required")
endif()
if(NOT DEFINED E084_DRV_DIR)
  message(FATAL_ERROR "-DE084_DRV_DIR=<dir with e084_drv.c> is required")
endif()

target_sources(app PRIVATE src/main.c)
target_include_directories(app PRIVATE ${SPINEL_GEN_DIR} ${E084_DRV_DIR})
if(DEFINED E084_TRAP)
  target_compile_definitions(app PRIVATE E084_TRAP=${E084_TRAP})
endif()

zephyr_link_libraries(${SPINEL_OBJ} ${SPINEL_GRAD_OBJ})
```

## prj.conf
```kconfig
CONFIG_PRINTK=y
# The canonical value ABI is 64-bit (P003 D-1), so %lld has to work in the
# trap hook's diagnostic.
CONFIG_PICOLIBC_IO_LONG_LONG=y
# As in E079/E083: no CONFIG_PICOLIBC_IO_FLOAT / CONFIG_CBPRINTF_FP_SUPPORT --
# the device prints IEEE bit patterns, never a decimal float, so the four-way
# comparison cannot be weakened by printf implementations, and `libm: none`
# stays true on both sides of the boundary.
#
# 16K, not E083's 8K: the hvp shim keeps a VLA shadow of the data buffer
# (64 rows x 5 doubles = 2560 B) on the stack, under the Newton-CG kernel
# frame.  MEASURED: the whole stream also completes bit-identically at 8K
# (probe build -DCONFIG_MAIN_STACK_SIZE=8192, E084 session); 16K is chosen
# headroom for the VLA, whose size scales with the data buffer.
CONFIG_MAIN_STACK_SIZE=16384
```

## src/main.c
```c
/* E084 -- the DEVICE leg (Cortex-M33 / RV32 under QEMU).
 *
 * Zephyr glue and nothing else.  The driver is drv/e084_drv.c, byte-identical
 * to the one the native leg compiles; the prototypes come from
 * `spinel-mlirgen --emit-header` plus spinel-gradfs's --emit-header (the hvp
 * prototype).  What is new compared with E083's device: the image holds a
 * NEWTON-CG loop inside the kernel object -- main.c calls no gradient or
 * Hessian-vector function and holds no loop; the kernel reaches BOTH adjoint
 * products through the platform externs the profile declares, and west linked
 * the --grads-only object next to it (see ../CMakeLists.txt).
 *
 * The trap hook panics: nothing in the calibration stream is supposed to
 * trap, so the honest hook is the one a sensor node would ship (E067 s5).
 * The E084_TRAP probe build relies on exactly that -- the UNREACHED line
 * must never print because k_panic() does not return.
 */
#include <zephyr/kernel.h>
#include <zephyr/sys/printk.h>
#include <stdint.h>

#include "spinel_freestanding.h"

void spinel_trap(int32_t code, int64_t a, int64_t b, const char *detail)
{
	printk("E084\tTRAP\tcode=%d a=%lld b=%lld detail=%s\n",
	       (int)code, (long long)a, (long long)b, detail);
	k_panic();
	for (;;) {
	}
}

#define E084_PRINT(...) printk(__VA_ARGS__)
#include "e084_drv.c"

int main(void)
{
	e084_main();
	return 0;
}
```
