## CMakeLists.txt
```
# tools/zephyr-full/host -- the Zephyr application that carries a hosted
# Spinel program and its runtime on Zephyr's POSIX layer (decision 0038).
#
# tools/zephyr-full/spinel-zephyr-full configures it; the variables it passes:
#   SP_VENDOR  the Spinel checkout whose runtime is compiled here
#   SP_OUT     the directory holding the program's generated app.c
#   SP_SHIM    decision 0032's header stand-ins (tools/npu/host/shim)
#   SP_ROOT    this repository, mapped out of __FILE__ in the image
#   SP_PEER    optional HOST:PORT, set as ZFULL_PEER for the program
#   SP_TRACE_IO  optional: print each read/fcntl/send/recv/connect/poll
cmake_minimum_required(VERSION 3.20.0)
find_package(Zephyr REQUIRED HINTS $ENV{ZEPHYR_BASE})
project(spinel_zephyr_full)

# the runtime's members and the regexp engine, as the Spinel Makefile lists them
set(V ${SP_VENDOR})
file(STRINGS ${V}/Makefile MK REGEX "^(RT_MEMBERS|RE_SRC) *=")
set(SRCS)
foreach(l ${MK})
  string(REGEX REPLACE "^[A-Z_]+ *= *" "" w "${l}")
  separate_arguments(w)
  if(l MATCHES "^RT_MEMBERS")
    foreach(m ${w})
      list(APPEND SRCS ${V}/lib/${m}.c)
    endforeach()
  else()
    foreach(m ${w})
      list(APPEND SRCS ${V}/${m})
    endforeach()
  endif()
endforeach()
if(NOT SRCS)
  message(FATAL_ERROR "no RT_MEMBERS or RE_SRC in ${V}/Makefile")
endif()

# one thread, no signals, and fixed-size GC tables, as on the bare-metal lane
set(SP_DEFS SP_NO_SIGNALS SP_MAX_WORKERS=1 __wasi__ _GNU_SOURCE SP_ALLOC_STATS=1 SP_STR_SHAPE_MAX=1
  SP_GC_STACK_MAX=256 SP_GC_REMEMBERED_MAX=1024 SP_GC_MARK_STACK_MAX=256 SP_GC_PINNED_MAX=256 SP_DYN_SYMS_MAX=256)

# The runtime and the program are compiled inside Zephyr's build, so they see
# Zephyr's POSIX headers; force.h declares what those leave out, and the two
# shim directories come after them so that they only fill gaps.
add_library(spinel_rt STATIC ${SRCS} ${SP_OUT}/app.c)
target_link_libraries(spinel_rt PRIVATE zephyr_interface)
add_dependencies(spinel_rt zephyr_generated_headers)
target_compile_definitions(spinel_rt PRIVATE ${SP_DEFS})
target_include_directories(spinel_rt PRIVATE ${V}/lib ${V}/lib/regexp ${V}/lib/regexp/shim)
target_compile_options(spinel_rt PRIVATE -w -std=gnu2x -Os
  "SHELL:-include ${CMAKE_CURRENT_SOURCE_DIR}/force.h"
  "SHELL:-idirafter ${CMAKE_CURRENT_SOURCE_DIR}/shim" "SHELL:-idirafter ${SP_SHIM}"
  -ffile-prefix-map=${V}=spinel -ffile-prefix-map=${SP_OUT}=app -ffile-prefix-map=${SP_ROOT}=extended)
set_source_files_properties(${SP_OUT}/app.c PROPERTIES COMPILE_DEFINITIONS main=sp_app_main)
target_sources(app PRIVATE src/host.c)
target_compile_options(app PRIVATE -ffile-prefix-map=${SP_ROOT}=extended)
target_link_libraries(app PRIVATE spinel_rt)
if(SP_PEER)
  target_compile_definitions(app PRIVATE SP_PEER="${SP_PEER}")
endif()

# In user mode the program reaches only its memory domain: place the
# runtime's and the host's globals in sp_partition (src/host.c).
if(CONFIG_USERSPACE)
  set_property(TARGET zephyr_property_target APPEND PROPERTY COMPILE_OPTIONS
    "-l" $<TARGET_FILE_NAME:spinel_rt> "sp_partition"
    "-l" $<TARGET_FILE_NAME:app> "sp_partition")
endif()

if(SP_TRACE_IO)
  target_compile_definitions(app PRIVATE SP_TRACE_IO)
  zephyr_ld_options(-Wl,--wrap=read -Wl,--wrap=fcntl -Wl,--wrap=send -Wl,--wrap=recv -Wl,--wrap=connect -Wl,--wrap=poll)
endif()

# Zephyr's POSIX layer defines fdopen and fileno over its own descriptor
# table: its fdopen hands back the table entry as a FILE *, which picolibc's
# stdio (getline, fgets, fread, and fopen, which calls fdopen) cannot read.
# Link picolibc's own two from the SDK's libc.a, renamed, and send every call
# to them (src/host.c).
execute_process(COMMAND ${CMAKE_C_COMPILER} -mcpu=cortex-m33 -mthumb -specs=picolibc.specs -print-file-name=libc.a
  OUTPUT_VARIABLE PICOLIBC_A OUTPUT_STRIP_TRAILING_WHITESPACE)
if(NOT EXISTS ${PICOLIBC_A})
  message(FATAL_ERROR "the toolchain names no picolibc libc.a for cortex-m33: ${PICOLIBC_A}")
endif()
set(PS ${CMAKE_CURRENT_BINARY_DIR}/picolibc-stdio)
add_custom_command(OUTPUT ${PS}/fdopen.o ${PS}/fileno.o
  COMMAND ${CMAKE_COMMAND} -E make_directory ${PS}
  COMMAND ${CMAKE_COMMAND} -E chdir ${PS} ${CMAKE_AR} x ${PICOLIBC_A} libc_tinystdio_fdopen.c.o libc_tinystdio_fileno.c.o
  COMMAND ${CMAKE_OBJCOPY} --redefine-sym fdopen=sp_picolibc_fdopen ${PS}/libc_tinystdio_fdopen.c.o ${PS}/fdopen.o
  COMMAND ${CMAKE_OBJCOPY} --redefine-sym fileno=sp_picolibc_fileno ${PS}/libc_tinystdio_fileno.c.o ${PS}/fileno.o
  DEPENDS ${PICOLIBC_A})
target_sources(app PRIVATE ${PS}/fdopen.o ${PS}/fileno.o)
zephyr_ld_options(-Wl,--wrap=fdopen -Wl,--wrap=fileno)
```

## prj.conf
```kconfig
# tools/zephyr-full/host/prj.conf -- Zephyr's C library, POSIX layer and
# IPv4 networking for a hosted Spinel program (decision 0038)
CONFIG_PICOLIBC=y
# picolibc's printf writes floating point only with this; the runtime rounds
# Float#round(n) for large n through snprintf("%.*f")
CONFIG_PICOLIBC_IO_FLOAT=y
CONFIG_PRINTK=y
CONFIG_STDOUT_CONSOLE=y
# the runtime registers hooks with __attribute__((constructor))
CONFIG_STATIC_INIT_GNU=y
CONFIG_MAIN_STACK_SIZE=32768
# malloc's arena takes the RAM nothing else uses
CONFIG_COMMON_LIBC_MALLOC_ARENA_SIZE=-1
CONFIG_POSIX_API=y
CONFIG_NETWORKING=y
CONFIG_NET_IPV4=y
CONFIG_NET_IPV6=n
CONFIG_NET_TCP=y
CONFIG_NET_UDP=y
# Zephyr does not start DHCP by itself; src/host.c calls net_dhcpv4_start
CONFIG_NET_DHCPV4=y
CONFIG_NET_L2_ETHERNET=y
CONFIG_NET_MGMT=y
CONFIG_NET_MGMT_EVENT=y
CONFIG_NET_CONNECTION_MANAGER=y
CONFIG_DNS_RESOLVER=y
CONFIG_ENTROPY_GENERATOR=y
```

## userspace.conf
```kconfig
# tools/zephyr-full/host/userspace.conf -- run the program in a user-mode
# thread (decision 0038 records that it faults in the POSIX layer)
CONFIG_USERSPACE=y
```

## src/host.c
```c
/* tools/zephyr-full/host/src/host.c -- the Zephyr side of a hosted Spinel
 * program (decision 0038): start the network, run the program, and report
 * on the console in lines the board check reads:
 *   ZFULL BEGIN | ZFULL NET up|none | ZFULL MODE supervisor|user ...
 *   (the program's own output) | ZFULL GC <collections> | ZFULL EXIT <status>
 * (fields separated by tabs). Also the few functions the runtime needs that
 * neither Zephyr nor picolibc defines. */
#include <zephyr/kernel.h>
#include <zephyr/net/net_if.h>
#include <zephyr/net/dhcpv4.h>
#include <zephyr/net/conn_mgr_monitor.h>
#include <stdio.h>
#include <stdlib.h>
extern int sp_app_main(int argc, char **argv);
extern unsigned long long sp_gc_stat_collections;
static K_SEM_DEFINE(up, 0, 1);
static struct net_mgmt_event_callback cb;
static void on_event(struct net_mgmt_event_callback *c, uint64_t ev, struct net_if *i) { k_sem_give(&up); }
static char *argv[] = {"app", NULL};

static void run(void *a, void *b, void *c)
{
	int rc = sp_app_main(1, argv);
	printf("ZFULL\tGC\t%u\nZFULL\tEXIT\t%d\n", (unsigned)sp_gc_stat_collections, rc);
}

#ifdef CONFIG_USERSPACE
#include <zephyr/app_memory/app_memdomain.h>
#include <zephyr/sys/libc-hooks.h>
/* the runtime's and the program's globals (CMakeLists puts both libraries
 * here), with the C library's globals and its malloc arena: all the program
 * may touch in user mode */
K_APPMEM_PARTITION_DEFINE(sp_partition);
static struct k_mem_domain sp_domain;
K_THREAD_STACK_DEFINE(sp_stack, 32768);
static struct k_thread sp_thread;

static void run_user(void)
{
	struct k_mem_partition *parts[] = {
		&sp_partition,
#ifdef Z_LIBC_PARTITION_EXISTS
		&z_libc_partition,
#endif
#ifdef Z_MALLOC_PARTITION_EXISTS
		&z_malloc_partition,
#endif
	};
	int e = k_mem_domain_init(&sp_domain, ARRAY_SIZE(parts), parts);
	printf("ZFULL\tMODE\tuser\t%d\t%u\n", e, (unsigned)ARRAY_SIZE(parts));
	k_tid_t t = k_thread_create(&sp_thread, sp_stack, K_THREAD_STACK_SIZEOF(sp_stack), run, NULL, NULL, NULL,
				    K_PRIO_PREEMPT(1), K_USER, K_FOREVER);
	k_mem_domain_add_thread(&sp_domain, t);
	k_thread_start(t);
	k_thread_join(t, K_FOREVER);
}
#endif

/* the runtime reads these in its own constructors (sp_alloc_floors_from_env,
 * the slab probe), which Zephyr runs before main: set them first */
__attribute__((constructor(101))) static void sp_env(void)
{
	setenv("SPINEL_GC_SLAB", "0", 1);
	setenv("SPINEL_GC_THRESHOLD_KB", "16", 1);
#ifdef SP_PEER
	/* the network peer a program talks to, given at build time */
	setenv("ZFULL_PEER", SP_PEER, 1);
#endif
}

int main(void)
{
	printf("ZFULL\tBEGIN\n");
	net_mgmt_init_event_callback(&cb, on_event, NET_EVENT_L4_CONNECTED);
	net_mgmt_add_event_callback(&cb);
	net_dhcpv4_start(net_if_get_default());
	conn_mgr_mon_resend_status();
	printf("ZFULL\tNET\t%s\n", k_sem_take(&up, K_SECONDS(30)) == 0 ? "up" : "none");
#ifdef CONFIG_USERSPACE
	run_user();
#else
	printf("ZFULL\tMODE\tsupervisor\n");
	run(NULL, NULL, NULL);
#endif
	return 0;
}

#include <errno.h>
#define NOSYS(decl) decl { errno = ENOSYS; return -1; }
NOSYS(int getcontext(void *u))
NOSYS(int setcontext(const void *u))
NOSYS(int swapcontext(void *a, const void *b))
void makecontext(void *u, void (*f)(void), int n, ...) { }
int madvise(void *a, size_t n, int w) { return 0; }
/* isatty: upstream Spinel's runtime asks it of STDOUT at start (820b9a6a6) to
 * write a terminal through. Nothing here is a terminal, so STDOUT keeps the
 * buffering stdio gives it, as before that change. */
int isatty(int fd)
{
	errno = ENOTTY;
	return 0;
}
int posix_memalign(void **m, size_t a, size_t n)
{
	*m = aligned_alloc(a, n);
	return *m ? 0 : ENOMEM;
}

/* lstat: Zephyr's file system API has stat but no lstat (and no links). No
 * file system is configured here, so it fails like stat would. */
struct stat;
NOSYS(int lstat(const char *p, struct stat *s))

/* __freadahead: the bytes stdio has buffered and not yet handed out, which
 * sp_io reads (musl's name) before it waits on a descriptor. picolibc has no
 * such call; its buffered FILE is struct __file_bufio, private to the
 * library. The prefix below is picolibc 1.8.10's (tinystdio/stdio-bufio.h);
 * the build stops on any other version rather than read the wrong fields. */
#include <picolibc.h>
#if __PICOLIBC__ != 1 || __PICOLIBC_MINOR__ != 8 || __PICOLIBC_PATCHLEVEL__ != 10
#error "__freadahead mirrors picolibc 1.8.10's struct __file_bufio"
#endif
struct sp_bufio_prefix {
	struct __file_ext xfile;
	const void *ptr;
	uint8_t dir;
	uint8_t bflags;
	__off_t pos;
	char *buf;
	int size;
	int len;
	int off;
};
size_t __freadahead(FILE *f)
{
	size_t n = 0;

	if (f->flags & __SBUF) {
		struct sp_bufio_prefix *b = (struct sp_bufio_prefix *)f;

		if (b->dir == __SRD && b->len > b->off) {
			n = (size_t)(b->len - b->off);
		}
	}
	return n + (f->unget != 0);
}

/* exit() from the program (an uncaught exception, exit 1) ends here; Zephyr's
 * weak _exit prints only "exit", so print the same lines main prints */
void _exit(int status)
{
	printf("ZFULL\tGC\t%u\nZFULL\tEXIT\t%d\n", (unsigned)sp_gc_stat_collections, status);
	for (;;)
		k_sleep(K_FOREVER);
}

#ifdef SP_TRACE_IO
/* linked with --wrap: each call's result and errno, on the console */
#include <stdarg.h>
#include <sys/types.h>
#include <sys/socket.h>
ssize_t __real_read(int fd, void *b, size_t n);
ssize_t __wrap_read(int fd, void *b, size_t n)
{
	ssize_t r = __real_read(fd, b, n); int e = errno;
	printk("TRACE\tread\t%d\t%u\t%d\t%d\n", fd, (unsigned)n, (int)r, e); errno = e; return r;
}
int __real_fcntl(int fd, int cmd, ...);
int __wrap_fcntl(int fd, int cmd, ...)
{
	va_list ap; va_start(ap, cmd); intptr_t a = va_arg(ap, intptr_t); va_end(ap);
	int r = __real_fcntl(fd, cmd, a); int e = errno;
	printk("TRACE\tfcntl\t%d\t%d\t%ld\t%d\t%d\n", fd, cmd, (long)a, r, e); errno = e; return r;
}
ssize_t __real_send(int fd, const void *b, size_t n, int fl);
ssize_t __wrap_send(int fd, const void *b, size_t n, int fl)
{
	ssize_t r = __real_send(fd, b, n, fl); int e = errno;
	printk("TRACE\tsend\t%d\t%u\t%d\t%d\t%d\n", fd, (unsigned)n, fl, (int)r, e); errno = e; return r;
}
ssize_t __real_recv(int fd, void *b, size_t n, int fl);
ssize_t __wrap_recv(int fd, void *b, size_t n, int fl)
{
	ssize_t r = __real_recv(fd, b, n, fl); int e = errno;
	printk("TRACE\trecv\t%d\t%u\t%d\t%d\t%d\n", fd, (unsigned)n, fl, (int)r, e); errno = e; return r;
}
int __real_connect(int fd, const struct sockaddr *a, socklen_t l);
int __wrap_connect(int fd, const struct sockaddr *a, socklen_t l)
{
	int r = __real_connect(fd, a, l); int e = errno;
	printk("TRACE\tconnect\t%d\t%d\t%d\n", fd, r, e); errno = e; return r;
}
int __real_poll(void *p, unsigned n, int t);
int __wrap_poll(void *p, unsigned n, int t)
{
	int r = __real_poll(p, n, t); int e = errno;
	printk("TRACE\tpoll\t%u\t%d\t%d\t%d\n", n, t, r, e); errno = e; return r;
}
#endif

/* picolibc's fdopen and fileno, renamed in CMakeLists.txt; --wrap sends the
 * runtime's calls and picolibc's own fopen here instead of to Zephyr's */
FILE *sp_picolibc_fdopen(int fd, const char *mode);
int sp_picolibc_fileno(FILE *f);
FILE *__wrap_fdopen(int fd, const char *mode) { return sp_picolibc_fdopen(fd, mode); }
int __wrap_fileno(FILE *f) { return sp_picolibc_fileno(f); }
```
