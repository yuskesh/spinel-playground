/*
 * The network firmware's MAC addresses: locally administered unicast values
 * (decision 0024's amendment, item 4; the board files' 00:00:00:... values
 * lie in another organisation's OUI), as tools/doom/net-probe measured them.
 */
&enetc_psi1 {
	local-mac-address = [02 53 50 01 03 00];
};

&switch_port0 {
	local-mac-address = [02 53 50 01 05 00];
};

&switch_port2 {
	local-mac-address = [02 53 50 01 07 00];
};

&switch_port4 {
	local-mac-address = [02 53 50 01 08 00];
};
